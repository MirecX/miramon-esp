## main/Kconfig.projbuild
```kconfig
menu "MyraMon Configuration"

    config MYRAMON_AP_SSID_PREFIX
        string "AP SSID prefix"
        default "MyraMon_"
        help
            Prefix for the access point SSID. The last 4 hex chars
            of the MAC address will be appended.

    config MYRAMON_AP_IP_ADDR
        string "AP IP address"
        default "192.168.4.1"
        help
            IP address for the access point.

    config MYRAMON_STA_TIMEOUT_SEC
        int "STA connection timeout (seconds)"
        default 30
        help
            Time to wait for STA connection before falling back to AP mode.

    config MYRAMON_TEMP_POLL_INTERVAL_MS
        int "Temperature polling interval (milliseconds)"
        default 10000
        help
            Interval for AJAX temperature polling.

endmenu
```

## sdkconfig.defaults
```kconfig
# MyraMon SDK Configuration Defaults

# Target: ESP32-S3
CONFIG_IDF_TARGET="esp32s3"

# Log level
CONFIG_LOG_DEFAULT_LEVEL_INFO=y
CONFIG_LOG_DEFAULT_LEVEL=3

# Debug output via USB-CDC
CONFIG_ESP_CONSOLE_USB_CDC=y
CONFIG_ESP_CONSOLE_USB_SERIAL_JTAG=y

# WiFi configuration
CONFIG_ESP_WIFI_SOFTAP_SUPPORT=y
CONFIG_ESP_WIFI_STA_DISCONNECTED_PM_ENABLE=y

# HTTP Server
CONFIG_HTTPD_MAX_REQ_HDR_LEN=512
CONFIG_HTTPD_MAX_URI_LEN=512
CONFIG_HTTPD_ERR_RESP_NO_DELAY=y
CONFIG_HTTPD_PURGE_BUF_LEN=32

# NVS
CONFIG_NVS_ENCRYPTION=n

# Partition table
CONFIG_PARTITION_TABLE_CUSTOM=y
CONFIG_PARTITION_TABLE_CUSTOM_FILENAME="partitions.csv"

# Flash size: 4MB
CONFIG_ESPTOOLPY_FLASHSIZE_4MB=y
```
